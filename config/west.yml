## config/west.yml
```yaml
manifest:
  remotes:
    - name: cormoran   # ★ 変更
      url-base: https://github.com/cormoran
    - name: badjeff
      url-base: https://github.com/badjeff
    - name: hsgw
      url-base: https://github.com/hsgw
    - name: caksoylar  # <-- led
      url-base: https://github.com/caksoylar

  projects:
    # ZMK 本体。★ 公式zmkfirmwareからcormoranフォークに切り替え
    - name: zmk
      remote: cormoran
      revision: v0.3-branch+dya
      import: app/west.yml

    # PMW3610 ドライバ（外部モジュール）
    - name: zmk-pmw3610-driver
      remote: badjeff
      revision: zmk-0.3
      # 置き場所を明示したい場合は path を指定（任意）
      # path: modules/zmk-pmw3610-driver
    
    # Sensor-rotation
    - name: zmk-feature-sensor_rotation
      remote: hsgw
      revision: main

    # LED
    - name: zmk-rgbled-widget  # <-- led
      remote: caksoylar
      revision: v0.3

    # ★ DYA Studioモジュール
    - name: zmk-module-ble-management
      remote: cormoran
      revision: main
      
    - name: zmk-module-battery-history
      remote: cormoran
      revision: main
      
    - name: zmk-module-settings-rpc
      remote: cormoran
      revision: main
      
    - name: zmk-module-runtime-input-processor
      remote: cormoran
      revision: main

    - name: zmk-behavior-runtime-sensor-rotation
      remote: cormoran
      revision: main
      
  self:
    path: config
```
